## CMakeLists.txt
```
#SPDX-License-Identifier: Apache-2.0
cmake_minimum_required(VERSION 3.13.1)
find_package(Zephyr REQUIRED HINTS $ENV{ZEPHYR_BASE})
project(prac2)

target_sources(app PRIVATE   src/main.c )
#target_include_directories(app PRIVATE ../../myoslib/inc)
```

## prj.conf
```kconfig
CONFIG_GPIO=y
CONFIG_LOG_PRINTK=y
CONFIG_SHELL=y
CONFIG_INIT_STACKS=y
CONFIG_THREAD_STACK_INFO=y
CONFIG_KERNEL_SHELL=y
CONFIG_THREAD_MONITOR=y
CONFIG_BOOT_BANNER=n
CONFIG_THREAD_NAME=y
CONFIG_DEVICE_SHELL=y
CONFIG_POSIX_CLOCK=y
CONFIG_DATE_SHELL=y
CONFIG_THREAD_RUNTIME_STATS=y
CONFIG_STDOUT_CONSOLE=y
CONFIG_USB_DEVICE_PRODUCT="PRAC2"
CONFIG_USB_DRIVER_LOG_LEVEL_ERR=y
CONFIG_USB_CDC_ACM=y
CONFIG_USB_DEVICE_LOG_LEVEL_ERR=y
CONFIG_SERIAL=y
CONFIG_UART_INTERRUPT_DRIVEN=y
CONFIG_USB=y
CONFIG_USB_DEVICE_STACK=y
CONFIG_USB_UART_CONSOLE=y
CONFIG_UART_INTERRUPT_DRIVEN=y
CONFIG_UART_LINE_CTRL=y
CONFIG_UART_CONSOLE_ON_DEV_NAME="CDC_ACM_0"
CONFIG_UART_SHELL_ON_DEV_NAME="CDC_ACM_0"

CONFIG_LOG_BACKEND_UART=y
CONFIG_SHELL_BACKEND_SERIAL_INIT_PRIORITY=99
CONFIG_HEAP_MEM_POOL_SIZE=256
CONFIG_HW_STACK_PROTECTION=y
CONFIG_APPLICATION_DEFINED_SYSCALL=y
CONFIG_ASSERT=y
CONFIG_LOG=y
CONFIG_CONSOLE=y
CONFIG_SPI=y
CONFIG_CBPRINTF_FP_SUPPORT=y
#CONFIG_SPI_1=y
CONFIG_BT=y
CONFIG_BT=y
CONFIG_BT_DEBUG_LOG=y
CONFIG_BT_PERIPHERAL=y
CONFIG_BT_DEVICE_NAME="STATICP3"
CONFIG_BT_GATT_CLIENT=y
CONFIG_LOG_BUFFER_SIZE=2048
#CONFIG_RTT_CONSOLE=y
#CONFIG_USE_SEGGER_RTT=y
```

## src/main.c
```c
/**
******************************************************************************
* @file      apps/p2/src/main.c
* @author    Smitha Ratnam - 44425782
* @date      29032021
* @brief     The main thread. 
*            Initialises the USB device and the os_hci. 
*         REFERENCE: zephyr shell library api and documentation.
*****************************************************************************
*/

#include <stdio.h>
#include <zephyr.h>
#include <device.h>
#include <devicetree.h>
#include <drivers/gpio.h>
#include <stdlib.h>
#include <drivers/uart.h>
#include <usb/usb_device.h>
//#include "os_hci.h"
#include <ctype.h>
#include <logging/log.h>
#include <bluetooth/bluetooth.h>
// #include <bluetooth/hci.h>
// #include <bluetooth/conn.h>
// #include <bluetooth/uuid.h>
// #include <bluetooth/gatt.h>

LOG_MODULE_REGISTER(main);

 #define DEVICE_NAME CONFIG_BT_DEVICE_NAME
 #define DEVICE_NAME_LEN (sizeof(DEVICE_NAME) - 1)

#define ADV_LEN 12
//#define IBEACON_RSSI 0xb4

/* Advertising data */

static uint8_t manuf_data[ADV_LEN] = {
	0x01 /*SKD version */,
	0x83 /* STM32WB - P2P Server 1 */,
	0x20 /* GROUP A Feature  */,
	0x30 /* GROUP A Feature */,
	0x63 /* GROUP B Feature */,
	0x73 /* GROUP B Feature */,
	0x00, /* BLE MAC start -MSB */
	0x06,
	0x00,
	0x00,
	0x00,
	0x00 /* BLE MAC stop */
};

/* Set Scan Response data */
static const struct bt_data sd[] = {
	BT_DATA(BT_DATA_NAME_COMPLETE, DEVICE_NAME, DEVICE_NAME_LEN),
};

static const struct bt_data ad[] = {
 	//BT_DATA_BYTES(BT_DATA_FLAGS, (BT_LE_AD_GENERAL | BT_LE_AD_NO_BREDR)),
 	//BT_DATA(BT_DATA_NAME_COMPLETE, DEVICE_NAME, DEVICE_NAME_LEN),
 	BT_DATA(BT_DATA_MANUFACTURER_DATA, manuf_data, ADV_LEN)
};

void main(void)
{
	const struct device *dev = NULL;
	int ret;
   	char addr_s[BT_ADDR_LE_STR_LEN];
	bt_addr_le_t addr = {0};
	size_t count = 1;


    /* Initialise the USB driver */
	/* Check if device is available and accessible */
	dev = device_get_binding("CDC_ACM_0");

	if (!dev) {

		printk("USB device not found");
		return;
	}

    /* Enable the usb device */
	ret = usb_enable(NULL);

	if (ret != 0) {
		printk("Failed to enable USB");
		return;
	}

       // os_hci_init();
    
        int err = bt_enable(NULL);
        	if (err) {
		printk("Bluetooth init failed (err %d)\n", err);
		return;
	}

	printk("Bluetooth initialized\n");

	/* Start advertising */
	err = bt_le_adv_start(BT_LE_ADV_NCONN_IDENTITY, ad, ARRAY_SIZE(ad), sd, ARRAY_SIZE(sd));
	printk("%d",BT_LE_ADV_NCONN_IDENTITY);
	if (err) {
		printk("Advertising failed to start (err %d)", err);
		return;
	}

	bt_id_get(&addr, &count);
	bt_addr_le_to_str(&addr, addr_s, sizeof(addr_s));
    while(1) {
	printk("StaticP3 started, advertising as %s\n", addr_s);
	k_msleep(100);
	}

}
```
